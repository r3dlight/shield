## Kconfig
```kconfig
# SPDX-FileCopyrightText: 2023 - 2024 Ledger SAS
# SPDX-License-Identifier: Apache-2.0

menuconfig WITH_LIBSHIELD
	bool "libShield"

if WITH_LIBSHIELD

config MAX_THREAD_PER_TASK
	int "thread limit per task"
	default 1
	range 1 1 if WITH_SENTRY
	help
	  Maximum number of threads per task

endif

menuconfig WITH_SENTRY
	bool "Sentry Kernel support"
	select BUILD_RUST_MODULES

if WITH_SENTRY
osource "$(subprojects)/sentry/Kconfig"
endif
```

## configs/defconfig
```kconfig
CONFIG_WITH_LIBSHIELD=y
# CONFIG_WITH_SENTRY is not set
CONFIG_MAX_THREAD_PER_TASK=2
```
